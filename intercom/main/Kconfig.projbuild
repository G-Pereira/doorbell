## intercom/main/Kconfig.projbuild
```kconfig
menu LCD
config LCD_OVERCLOCK
	bool
	prompt "Run LCD at higher clock speed than allowed"
	default "n"
	help
		The ILI9341 specify that the maximum clock speed for the SPI interface is 10MHz. However,
		in practice the driver chip works fine with a higher clock rate, and using that gives a better framerate.
		Select this to try using the out-of-spec clock rate.
	menu Pins
        config PIN_MISO
            int "MISO"
            default 25
            help
                Pin number for MISO pin on the LCD
        config PIN_MOSI
            int "MOSI"
            default 23
            help
                Pin number for MOSI pin on the LCD
        config PIN_CLK
            int "CLK"
            default 19
            help
                Pin number for CLK pin on the LCD
        config PIN_CS
            int "CS"
            default 22
            help
                Pin number for Chip Select pin on the LCD
        config PIN_DC
            int "DC"
            default 21
            help
                Pin number for DC pin on the LCD
        config PIN_RST
            int "RST"
            default 18
            help
                Pin number for Reset pin on the LCD
        config PIN_BCKL
            int "LED/BCKL"
            default 5
            help
                Pin number for Backlight pin on the LCD
	endmenu
endmenu
```

## ringer/main/Kconfig.projbuild
```kconfig
menu "ESP32 Door Bell Configuration"

config WIFI_SSID
    string "WiFi SSID"
    default ""
    help
        SSID (network name) for the demo to connect to.

config WIFI_PASSWORD
    string "WiFi Password"
    default ""
    help
        Password for your network.
        
config XCLK_FREQ
    int "XCLK Frequency"
    default "20000000"
    help
        The XCLK Frequency in Herz.

config JPEG_QUALITY
    int "JPEG Quality"
    default "5"
    help
	The amount of compression (0-63)

menu "Pin Configuration"
    config CAM_PIN_D0
        int "D0"
        default "5"
    config CAM_PIN_D1
        int "D1"
        default "14"
    config CAM_PIN_D2
        int "D2"
        default "18"
    config CAM_PIN_D3
        int "D3"
        default "19"
    config CAM_PIN_D4
        int "D4"
        default "36"
    config CAM_PIN_D5
        int "D5"
        default "39"
    config CAM_PIN_D6
        int "D6"
        default "34"
    config CAM_PIN_D7
        int "D7"
        default "35"
    config CAM_PIN_XCLK
        int "XCLK"
        default "21"
    config CAM_PIN_PCLK
        int "PCLK"
        default "22"
    config CAM_PIN_VSYNC
        int "VSYNC"
        default "25"
    config CAM_PIN_HREF
        int "HREF"
        default "23"
    config CAM_PIN_SIOD
        int "SIOD"
        default "26"
    config CAM_PIN_SIOC
        int "SIOC"
        default "27"
    config CAM_PIN_RESET
        int "RESET"
        default "-1"
    config CAM_PIN_PWDN
        int "PWDN"
        default "-1"
    config PIR_PIN
        int "PIR"
        default "33"
    config BELL_BUT_PIN
        int "BELL_BUT"
        default "34"
endmenu

endmenu
```
